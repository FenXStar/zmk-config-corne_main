## config/west.yml
```yaml
manifest:
  remotes:
    - name: zmkfirmware
      url-base: https://github.com/zmkfirmware
    - name: carrefinho
      url-base: https://github.com/carrefinho
      
  projects:
    - name: zmk
      remote: zmkfirmware
      revision: 4ec69cb
      import: app/west.yml
  
    - name: prospector-zmk-module
      remote: carrefinho
      revision: 67425b7
      
  self:
    path: config
```
